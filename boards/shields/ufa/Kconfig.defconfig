## config/west.yml
```yaml
manifest:
  remotes:
    - name: zmkfirmware
      url-base: https://github.com/zmkfirmware
    - name: badjeff
      url-base: https://github.com/badjeff
    - name: george-norton
      url-base: https://github.com/george-norton
  projects:
    - name: zmk
      remote: zmkfirmware
      revision: main
      import: app/west.yml
    - name: zmk-paw3395-driver
      remote: badjeff
      revision: main
    - name: zmk-behavior-sensor-attr-cycle 
      remote: george-norton
      revision: main
  self:
    path: config
```
